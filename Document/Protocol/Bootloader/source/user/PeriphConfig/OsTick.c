/*
*****************************************Copyright (c)**********************************************
**
**
**                                  深圳摩罗志远科技有限公司
**                             Shenzhen Maono Technology Co.,Ltd
**
**                                        www.maono.cn
**
**
**	文件名	: OsTick.c
**
**	程序员	: 
**
**	日　期  : 2023年1月12日
**
**	文件描述: 系统Tick配置，和程序用到的延时函数。
**
****************************************************************************************************
*/
#include "OsTick.h"
#include "a0.h"
#include "a0_hal_def.h"



/* 宏定义 */
#define  DWT_CR					*(__IO uint32_t *)0xE0001000	// 使用CPU TS（时间戳）来做精准的延时
#define  DWT_CYCCNT				*(__IO uint32_t *)0xE0001004
#define  DEM_CR					*(__IO uint32_t *)0xE000EDFC

#define  DEM_CR_TRCENA			(1 << 24)
#define  DWT_CR_CYCCNTENA		(1 <<  0)


/* 函数声明 */
void   TickInit(void);
void   CpuTsInit(void);
uint32 TickTimerMs(uint32 *cnt, uint32 bit);
void   TickDelayMs(uint32 nMs);
void   TickDelayUs(uint32 nUs);
void   TickDelay  (uint32 nCount);


/* 变量定义和声明 */
OS_TICK_HANDLE OsTick =
{	
	.Init    = TickInit,
	.TimerMs = TickTimerMs,
	.DelayMs = TickDelayMs,
	.DelayUs = TickDelayUs,
	.Delay   = TickDelay,
};

uint32 FlagBits = 0;	/* 1ms 标志，位数越多，复用的定时器也越多
						   它要在 SysTick_Handler 中断中赋值
						*/

/*
****************************************************************************************************
**
**                                           TickInit()
**
**
**	功能描述: SysTick初始化。
**
**	参  数  : 
**
**	返回值  : 
**
****************************************************************************************************
*/
void TickInit(void)
{
	HAL_TickInit();
	CpuTsInit();
}


/*
****************************************************************************************************
**
**                                           CpuTsInit()
**
**
**	功能描述: 使用CPU TS来做精准时间延时
**
**	参  数  : 
**
**	返回值  : 
**
****************************************************************************************************
*/
void CpuTsInit(void)
{
	DEM_CR    |= (uint32)DEM_CR_TRCENA;		// 使能DWT外设
	DWT_CYCCNT = (uint32)0u;				// DWT CYCCNT寄存器计数清0
	DWT_CR    |= (uint32)DWT_CR_CYCCNTENA;	// 使能Cortex-M DWT CYCCNT寄存器
}


/*
****************************************************************************************************
**
**                                        TickTimerMs()
**
**
**	功能描述: 定时器复用，实现多个定时功能。最小单位为 ms 的定时器。
**
**	参  数  : cnt		定时计数 cnt*1ms
**			  bit		利用定时器的选择，共32个。由FlagBits的位数决定
**
**	返回值  : true:计数结束，false: 计数继续
**
**	备  注  : 这是扫描式定时，中断服务函数中对全局变量置位，调用本函数时才减 1，定时会随着循环
**			  时间的长短而不同，需要注意。
**
****************************************************************************************************
*/
uint32 TickTimerMs(uint32 *cnt, uint32 bit)
{
	if (*cnt != 0)
	{
		if (FlagBits & bit)
		{
			FlagBits &= ~bit;
			(*cnt)--;
		}

		if (*cnt == 0)
		{
			return true;
		}
   	}

	return false;
}


/*
****************************************************************************************************
**
**                                           SysTick_Handler()
**
**
**	功能描述: 系统滴答时钟中断服务函数。
**
**	参  数  : 
**
**	返回值  : 
**
****************************************************************************************************
*/
//void SysTick_Handler(void)
//{
//	FlagBits = 0xFFFFFFFF;
//}


/*
****************************************************************************************************
**
**                                           TickDelayMs()
**
**
**	功能描述: DelayMs 毫秒延时，用SysTick即可。
**
**	参  数  : nms为要延时的ms数
**
**	返回值  : 
**
**  备  注  : 
**
****************************************************************************************************
*/
void TickDelayMs(uint32 nMs)
{
	TickDelayUs(nMs * 1000);
}


/*
****************************************************************************************************
**
**                                           TickDelayUs()
**
**
**	功能描述: DelayUs 微秒延时。时间在1ms以下，超过1ms，就不要使用此函数。
**
**	参  数  : nUs为要延时的us数。nUs < 1000
**
**	返回值  : 
**
****************************************************************************************************
*/
void TickDelayUs(uint32 nUs)
{
	uint32 ticks;
	uint32 tOld, tNow, tCnt = 0;


	ticks = nUs * 192;							// 需要的节拍数
	tCnt  = 0;
	tOld  = (uint32)DWT_CYCCNT;	     	    	// 刚进入时的计数器值

	while (1)
	{
		tNow = (uint32)DWT_CYCCNT;
		
		if (tNow != tOld)
		{
			if (tNow > tOld)					// 32位计数器是递增计数器
			{
				tCnt += tNow - tOld;
			}
			else 								// 重新装载
			{
				tCnt += UINT32_MAX - tOld + tNow;
			}

			tOld = tNow;

			if (tCnt >= ticks)					// 时间超过/等于要延迟的时间,则退出
			{
				break;
			}
		}
	}
}


/*
****************************************************************************************************
**
**                                          TickDelay()
**
**
**	功能描述: 系统简单延时。程序中尽量不要用此函数，它受太多因素影响了。比如MCU主频，Keil代码优化
**            等级等等。
**
**	参  数  : nCount
**
**	返回值  : 
**
****************************************************************************************************
*/
void TickDelay(uint32 nCount)
{
	while (nCount--);
}




